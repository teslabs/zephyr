## drivers/clock_control/Kconfig.sf32lb
```kconfig
# Copyright (c) 2025 Core Devices LLC
# SPDX-License-Identifier: Apache-2.0

config CLOCK_CONTROL_SF32LB
	bool "SF32LB clock control driver"
	default y
	depends on DT_HAS_SIFLI_SF32LB_RCC_CLK_ENABLED
	help
	  Enable driver for SiFli SF32LB clock control.
```

## drivers/hwinfo/Kconfig.sf32lb
```kconfig
# Copyright 2025 Core Devices LLC
# SPDX-License-Identifier: Apache-2.0

config HWINFO_SF32LB
	bool "SiFli SF32LB hwinfo driver"
	default y
	depends on SOC_SERIES_SF32LB52X
	select HWINFO_HAS_DRIVER
	help
	  Enable SF32LB hwinfo driver
```

## drivers/nvmem_provider/Kconfig
```kconfig
# Copyright (c) 2025 Core Devices LLC
# SPDX-License-Identifier: Apache-2.0

menuconfig NVMEM_PROVIDER
	bool "NVMEM provider drivers"
	help
	  Enables support for drivers that provide access to Non-Volatile Memory
	  (NVMEM).

if NVMEM_PROVIDER

module = NVMEM_PROVIDER
module-str = nvmem_provider
source "subsys/logging/Kconfig.template.log_config"

config NVMEM_PROVIDER_INIT_PRIORITY
	int "NVMEM provider devices init priority"
	default 40
	help
	  NVMEM provider devices initialization priority.

endif # NVMEM_PROVIDER
```

## drivers/nvmem_provider/Kconfig.sf32lb_efusec
```kconfig
# Copyright (c) 2025 Core Devices LLC
# SPDX-License-Identifier: Apache-2.0

config NVMEM_PROVIDER_SF32LB_EFUSEC
	bool "SiFli SF32LB NVMEM provider driver for EFUSEC"
	default y
	depends on DT_HAS_SIFLI_SF32LB_EFUSEC_ENABLED
	help
	  Enable NVMEM provider driver for SiFli SF32LB EFUSE Controller
	  (EFUSEC).
```

## dts/bindings/clock/sifli,sf32lb-rcc-clk.yaml
```yaml
# Copyright (c) 2025 Core Devices LLC
# SPDX-License-Identifier: Apache-2.0

description: |
  SiFli Reset and Clock Controller (RCC) is a multi-function peripheral in
  charge of reset control and clock control for all SoC peripherals. This
  binding represents the clock controller part. It is meant to be used as a
  child node of the RCC node. This is due to the fact Zephyr does not allow
  >1 device referencing to the same devicetree node (e.g. clock and reset
  devices).

  To specify the clocks in a peripheral, the standard clocks property needs
  to be used, e.g.:

    usart1: serial@xxx {
        ...
        /* cell encodes RCC register offset and control bit position */
        clocks = <&rcc_clk SF32LB52X_CLOCK_USART1>;
        ...
    }

  Predefined RCC clock cells are available in
  include/zephyr/dts-bindings/clock/sf32lb{xxx}-clocks.h header files, where
  {xxx} corresponds to the SoC series, e.g. sf32lb52x.

compatible: "sifli,sf32lb-rcc-clk"

include: [clock-controller.yaml, base.yaml]

properties:
  clocks:
    required: true

  clock-names:
    required: true

  "#clock-cells":
    const: 1

clock-cells:
  - id
```

## dts/bindings/nvmem/sifli,sf32lb-efusec.yaml
```yaml
# Copyright (c) 2025 Core Devices LLC
# SPDX-License-Identifier: Apache-2.0

description: SiFli SF32LB EFUSE Controller

compatible: "sifli,sf32lb-efusec"

include: [base.yaml, "sifli-sf32lb-pmuc.yaml"]

properties:
  reg:
    required: true

  clocks:
    required: true

  interrupts:
    required: true

  sifli,pmuc:
    required: true
```

## samples/hello_world/boards/testboard/Kconfig.testboard
```kconfig
# Copyright (c) 2024 Nordic Semiconductor ASA
# SPDX-License-Identifier: Apache-2.0

config BOARD_TESTBOARD
	select SOC_NRF54L15_CPUAPP if BOARD_TESTBOARD_NRF54L15_CPUAPP
	select SOC_NRF54L15_CPUFLPR if BOARD_TESTBOARD_NRF54L15_CPUFLPR || \
					    BOARD_TESTBOARD_NRF54L15_CPUFLPR_XIP
```

## samples/hello_world/boards/testboard/board.yml
```yaml
board:
  name: testboard
  full_name: Test Board DK
  vendor: nordic
  socs:
  - name: nrf54l15
    variants:
    - name: xip
      cpucluster: cpuflpr
```

## subsys/nvmem/Kconfig
```kconfig
# Copyright (c) 2025 Basalte bv
# SPDX-License-Identifier: Apache-2.0

menuconfig NVMEM
	bool "Non Volatile Memory (NVMEM)"

if NVMEM

config NVMEM_EEPROM
	bool "NVMEM support for EEPROM devices"
	default y
	depends on EEPROM

config NVMEM_NVMEM_PROVIDER
	bool "NVMEM support for NVMEM provider devices"
	default y
	depends on NVMEM_PROVIDER

module = NVMEM
module-str = nvmem
source "subsys/logging/Kconfig.template.log_config"

endif # NVMEM
```
