/*
 * Copyright (C) 2024 Nordic Semiconductor ASA
 * SPDX-License-Identifier: Apache-2.0
 */

&i3c120 {
	lps22hh@5c0000020800b30000 {
		compatible = "st,lps22hh";
		reg = <0x5c 0x208 0xb30000>;
		assigned-address = <0xa>;
	};
};
