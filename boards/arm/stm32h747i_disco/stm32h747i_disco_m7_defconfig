## boards/arm/stm32h747i_disco/stm32h747i_disco_m7_defconfig
```kconfig
# SPDX-License-Identifier: Apache-2.0

CONFIG_SOC_SERIES_STM32H7X=y
CONFIG_SOC_STM32H747XX=y

# Board config should be specified since there are 2 possible targets
CONFIG_BOARD_STM32H747I_DISCO_M7=y

# enable pinmux
CONFIG_PINMUX=y

# enable GPIO
CONFIG_GPIO=y

# clock configuration
CONFIG_CLOCK_CONTROL=y

# Clock configuration for Cube Clock control driver
CONFIG_CLOCK_STM32_HSE_CLOCK=25000000
CONFIG_CLOCK_STM32_SYSCLK_SRC_PLL=y

# use HSE (bypass) as PLL input
CONFIG_CLOCK_STM32_PLL_SRC_HSE=y
CONFIG_CLOCK_STM32_HSE_BYPASS=y

# produce 400MHz clock at PLL output
CONFIG_CLOCK_STM32_PLL_M_DIVISOR=5
CONFIG_CLOCK_STM32_PLL_N_MULTIPLIER=160
CONFIG_CLOCK_STM32_PLL_P_DIVISOR=2
CONFIG_CLOCK_STM32_PLL_Q_DIVISOR=4
CONFIG_CLOCK_STM32_PLL_R_DIVISOR=2

# Enable MPU
CONFIG_ARM_MPU=y

# Enable HW stack protection
CONFIG_HW_STACK_PROTECTION=y

# Enable SDRAM
CONFIG_MEMC=y
CONFIG_MEMC_STM32_SDRAM=y

# produce 27.5 MHz at PLL3 R output (for LTDC)
CONFIG_CLOCK_STM32_PLL3_ENABLE=y
CONFIG_CLOCK_STM32_PLL3_M_DIVISOR=5
CONFIG_CLOCK_STM32_PLL3_N_MULTIPLIER=132
CONFIG_CLOCK_STM32_PLL3_R_ENABLE=y
CONFIG_CLOCK_STM32_PLL3_R_DIVISOR=24

# Enable DSI
CONFIG_MIPI_DSI=y

# Enable OTM8009A display
CONFIG_DISPLAY=y
CONFIG_OTM8009A=y

# Disable following to assign serial ports to m4 core

# enable uart driver
CONFIG_SERIAL=y
# console
CONFIG_CONSOLE=y
CONFIG_UART_CONSOLE=y
```

## boards/arm/tinymovr_m5/Kconfig.board
```kconfig
# Copyright (c) 2023, Teslabs Engineering S.L.
# SPDX-License-Identifier: Apache-2.0

config BOARD_TINYMOVR_M5
	bool "Tinymovr M5"
	depends on SOC_PAC5527
```

## boards/arm/tinymovr_m5/Kconfig.defconfig
```kconfig
# Copyright (c) 2023 Teslabs Engineering S.L.
# SPDX-License-Identifier: Apache-2.0

config BOARD
	default "tinymovr_m5" if BOARD_TINYMOVR_M5
```

## boards/arm/tinymovr_m5/tinymovr_m5_defconfig
```kconfig
# Copyright (c) 2023, Teslabs Engineering S.L.
# SPDX-License-Identifier: Apache-2.0

CONFIG_SOC_SERIES_PAC55XX=y
CONFIG_SOC_PAC5527=y
CONFIG_BOARD_TINYMOVR_M5=y

CONFIG_SERIAL=y
CONFIG_CONSOLE=y
CONFIG_UART_CONSOLE=y
```

## boards/shields/nordic_pca63566/Kconfig.shield
```kconfig
# Copyright (c) 2024 Nordic Semiconductor ASA
# SPDX-License-Identifier: Apache-2.0

config SHIELD_NORDIC_PCA63566
	def_bool $(shields_list_contains,nordic_pca63566)
```

## drivers/clock_control/Kconfig.gd32
```kconfig
# Copyright (c) 2022 Teslabs Engineering S.L.
# SPDX-License-Identifier: Apache-2.0

DT_COMPAT_GD_GD32_RCU := gd,gd32-rcu

config CLOCK_CONTROL_GD32
	bool "GD32 clock control"
	depends on (SOC_FAMILY_GD32 || SOC_SERIES_GD32VF103)
	default $(dt_compat_enabled,$(DT_COMPAT_GD_GD32_RCU))
	help
	  Enable driver for Gigadevice Reset Clock Unit (RCU).
```

## drivers/display/Kconfig.otm8009a
```kconfig
# OTM8009A display driver configuration options

# Copyright (c) 2020 Teslabs Engineering S.L.
# SPDX-License-Identifier: Apache-2.0

config OTM8009A
	bool "OTM8009A display driver"
	depends on MIPI_DSI
	help
	  Enable driver for OTM8009A display driver.
```

## drivers/i3c/Kconfig.dw
```kconfig
# Copyright (c) 2023 Meta Platforms, Inc. and its affiliates.
#
# SPDX-License-Identifier: Apache-2.0

config I3C_DW
	bool "DW I3C support"
	select I3C_IBI_WORKQUEUE if I3C_USE_IBI
	depends on DT_HAS_SNPS_DW_I3C_MASTER_1_00A_ENABLED
	default y
	help
	  Enable the Synopsys Designware I3C driver

config I3C_DW_WRAPPER
	bool
	depends on I3C_DW
	help
	  Select this option if Synopsys Designware I3C controller is wrapped
	  in a vendor-specific IP block.
```

## drivers/i3c/Kconfig.nrf
```kconfig
# Copyright (c) 2024 Nordic Semiconductor ASA
# SPDX-License-Identifier: Apache-2.0

config I3C_NRF
	bool "Nordic nRF I3C support"
	depends on DT_HAS_NORDIC_NRF_I3C_ENABLED
	select I3C_DW_WRAPPER
	select PINCTRL
	default y
	help
	  Enable the Nordic nRF I3C driver
```

## drivers/mipi_dsi/Kconfig.stm32
```kconfig
# Copyright (c) 2020 Teslabs Engineering S.L.
# SPDX-License-Identifier: Apache-2.0

config MIPI_DSI_STM32
	bool "Enable STM32 MIPI-DSI Host Controller"
	depends on SOC_SERIES_STM32H7X
	select USE_STM32_HAL_DSI
	select USE_STM32_HAL_LTDC
	help
	  Enable STM32 MIPI-DSI Host Controller.

	  Note that PLL3 needs to be configured to be able to use the LTDC
	  peripheral.
```

## drivers/pinctrl/Kconfig.pac55xx
```kconfig
# Copyright (c) 2023 Teslabs Engineering S.L.
# SPDX-License-Identifier: Apache-2.0

config PINCTRL_PAC55XX
	bool "Qorvo PAC55XX pin controller driver"
	default y
	depends on DT_HAS_QORVO_PAC55XX_PINCTRL_ENABLED
	help
	  Qorvo PAC55XX pin controller driver.
```

## drivers/serial/Kconfig.pac55xx
```kconfig
# Copyright (c) 2023 Teslabs Engineering S.L.
# SPDX-License-Identifier: Apache-2.0

config UART_PAC55XX
	bool "Qorvo PAC55XX UART driver"
	default y
	depends on DT_HAS_QORVO_PAC55XX_USART_ENABLED
	select PINCTRL
	select SERIAL_HAS_DRIVER
	help
	  This option enables the USART driver for Qorvo PAC55XX SoC family.
```

## dts/bindings/clock/gd,gd32vf103-pll-clock.yaml
```yaml
# Copyright (c) 2022, TOKITA Hiroshi
# SPDX-License-Identifier: Apache-2.0

description: |
  GD32VF103 PLL.

  The PLL input can use IRC8M/2 or PREDV0 output.
  Output frequency is input clock frequency multiplied clock-mult value.

  The PLL output frequency must not exceed 108MHz.

compatible: "gd32,gd32vf103-pll-clock"

include: fixed-factor-clock.yaml

properties:
    clock-mult:
      description:
        Main PLL multiplication factor.
        ** Note ** For x6.5 multiplier value, please use "mul = <15>;"
      enum:
        - 4
        - 5
        - 6
        - 7
        - 8
        - 9
        - 15 # treat as x6.5
        - 16
        - 17
        - 18
        - 19
        - 20
        - 21
        - 22
        - 23
        - 24
        - 25
        - 26
        - 27
        - 28
        - 29
        - 30
        - 31
        - 32
```

## dts/bindings/clock/gd,gd32vf103-plln-clock.yaml
```yaml
# Copyright (c) 2022, TOKITA Hiroshi
# SPDX-License-Identifier: Apache-2.0

description: |
  GD32VF103 PLL1, PLL2

  Outputs the frequency obtained by multiplying PREDV1
  by the clock-mult value.

compatible: "gd32,gd32vf103-plln-clock"

include: fixed-factor-clock.yaml

properties:
    clock-mult:
      enum:
        - 8
        - 9
        - 10
        - 11
        - 12
        - 13
        - 14
        - 16
        - 20
```

## dts/bindings/clock/gd,gd32vf103-predv.yaml
```yaml
# Copyright (c) 2022, TOKITA Hiroshi
# SPDX-License-Identifier: Apache-2.0

description: |
  GD32VF103 PREDVn divider

  Outputs the frequency obtained by dividing input frequency
  by the clock-div value.
  The input is can select HXTAL and PLL1.
  (PLL1 is PREDV0 case only.)

compatible: "gd32,gd32vf103-predv"

include: fixed-factor-clock.yaml

properties:
    clock-div:
      enum:
        - 1
        - 2
        - 3
        - 4
        - 5
        - 6
        - 7
        - 8
        - 9
        - 10
        - 11
        - 12
        - 13
        - 14
        - 15
        - 16
```

## dts/bindings/display/orisetech,otm8009a.yaml
```yaml
# Copyright (c) 2020 Teslabs Engineering S.L.
# SPDX-License-Identifier: Apache-2.0

description: OTM8009A display controller

compatible: "orisetech,otm8009a"

include: mipi-dsi-device.yaml

properties:
    reset-gpios:
      type: phandle-array
      required: false
      description: Reset pin (active low).

    bl-gpios:
      type: phandle-array
      required: false
      description: Back-light pin.

    rotation:
      type: int
      default: 0
      enum:
        - 0
        - 90
        - 180
        - 270
      description:
        Display rotation (CW) in degrees.
```

## dts/bindings/gpio/qorvo,pac55xx-gpio.yaml
```yaml
# Copyright (c) 2023 Teslabs Engineering S.L.
# SPDX-License-Identifier: Apache-2.0

description: Qorvo PAC55XX GPIO

compatible: "qorvo,pac55xx-gpio"

include: [gpio-controller.yaml, base.yaml]

properties:
  reg:
    required: true

  "#gpio-cells":
    const: 2

gpio-cells:
  - pin
  - flags
```

## dts/bindings/i3c/nordic,nrf-i3c.yaml
```yaml
# Copyright (c) 2024 Nordic Semiconductor ASA
# SPDX-License-Identifier: Apache-2.0

description: Nordic nRF I3C

compatible: "nordic,nrf-i3c"

include: ["snps,dw-i3c-master-1.00a.yaml", pinctrl-device.yaml, nordic-clockpin.yaml]

properties:
  pinctrl-0:
    required: true

  pinctrl-names:
    required: true
```

## dts/bindings/mipi-dsi/st,stm32-dsi.yaml
```yaml
# Copyright (c) 2020, Teslabs Engineering S.L.
# SPDX-License-Identifier: Apache-2.0

description: STM32 MIPI-DSI Host Controller

compatible: "st,stm32-dsi"

include: mipi-dsi-host.yaml

properties:
    reg:
      required: true

    clocks:
      required: true

    st,ltdc:
      type: phandle
      required: true
      description: |
        Instance of the LTDC peripheral. MIPI-DSI driver takes care of enabling
        LTDC to work with the DSI peripheral.

    st,pll:
      type: array
      required: true
      description: |
        PLL settings in the following order: NDIV, IDF, ODF. Valid ranges are:

        - NDIV: [10, 125]
        - IDF: [1, 7]
        - ODF: 1, 2, 4, 8

        The PLL output clock (HS) is the clock fed to the D-PHY. It must be
        between 80 MHz and 500 MHz. The D-PHY uses the HS clock to generate a
        half-rate DDR clock which is transmitted to the display using the
        clock lane. The D-PHY also divides the HS clock by eight to generate the
        Lane_byte_clock which is fed to the DSI Host. The following formulae can
        be used to obtain the clock values:

          fVCO = (HSE / IDF) * 2 * NDIV
          HS = fVCO / (2 * ODF)
          Lane_byte_clock = HS / 8

        Example:

          - HSE: 25 MHz
          - NDIV: 20
          - IDF: 1
          - ODF: 1

          fVCO = (25 MHz / 1) * 2 * 20 = 1 GHz
          HS = 1 GHz / (2 * 1) = 500 MHz
          Lane_byte_clock = 500 Mhz / 8 = 62.5 MHz

        Ref. AN4860 rev. 2, 5.1.2.

    st,txeckdiv:
      type: int
      required: true
      description: |
        TX escape clock division (TXECKDIV). TXECKDIV must be set to a value
        higher than 2. Values 0 or 1 disable the generation of the TX escape
        clock.

        The TX escape clock (tx_esc_clk) is used in LP mode. It needs to be less
        than 20 MHz. It is given by:

          tx_esc_clk = Lane_byte_clk / TXECKDIV.

        Example:

          - Lane_byte_clk: 62.5 MHz
          - TXECKDIV: 4

          tx_esc_clk = 62.5 MHz / 4 = 15.625 MHz
```

## dts/bindings/mipi-dsi/st,stm32-ltdc.yaml
```yaml
# Copyright (c) 2020, Teslabs Engineering S.L.
# SPDX-License-Identifier: Apache-2.0

description: STM32 LTDC TFT-LCD controller

compatible: "st,stm32-ltdc"

include: base.yaml

properties:
    reg:
      required: true

    label:
      required: true

    clocks:
      required: true
```

## dts/bindings/pinctrl/nordic-clock-enable.yaml
```yaml
# Copyright (c) 2024 Nordic Semiconductor ASA
# SPDX-License-Identifier: Apache-2.0

properties:
  nordic,clock-enable:
    type: array
    description: |
      Mask of signals that require clock enablement (CLOCKPIN).
```

## dts/bindings/pinctrl/qorvo,pac55xx-pinctrl.yaml
```yaml
# Copyright (c) 2023 Teslabs Engineering S.L.
# SPDX-License-Identifier: Apache-2.0

description: |
    The Qorvo PAC55XX pin controller is a singleton node responsible for
    controlling pin function selection and pin properties.

    The node has the 'pinctrl' node label set in your SoC's devicetree,
    so you can modify it like this:

      &pinctrl {
        /* your modifications go here */
      };

    All device pin configurations should be placed in child nodes of the
    'pinctrl' node, as shown in this example:

      /* You can put this in places like a board-pinctrl.dtsi file in
       * your board directory, or a devicetree overlay in your application.
       */

      /* include pre-defined configurations */
      #include <zephyr/dt-bindings/pinctrl/pac55xx-pinctrl.h>

      &pinctrl {
        /* configuration for the usarta "default" state */
        usarta_default: usarta_default {
          group1 {
            /* configure PA4 as USARTA TX, output in push-pull mode */
            pinmux = <USARTA_TX_PA4>;
            drive-push-pull;
          };
          group2 {
            /* configure PA5 as USARTA RX, input with pull-up */
            pinmux = <USARTA_RX_PA5>;
            bias-pull-up;
          };

    The 'usarta_default' child node encodes the pin configurations for a
    particular state of a device; in this case, the default (that is, active)
    state.

    As shown, pin configurations are organized in groups within each child node.
    Each group can specify a list of pin function selections in the 'pinmux'
    property.

    A group can also specify shared pin properties common to all the specified
    pins, such as the 'bias-pull-up' property in group2. Here is a list of
    supported standard pin properties:

    - drive-push-pull: Push-pull output drive mode.
    - drive-open-drain: Open-drain output drive mode.
    - bias-pull-up: Enable pull-up resistor.
    - bias-pull-down: Enable pull-down resistor.
    - drive-strength: Drive strength (defaults to 6mA, HW default).
    - input-schmitt-enable: Enable Schmitt trigger on input.

    By default pins will be configured in high-impedance input mode, output
    mode will be configured when providing one of the drive-* properties.

    To link pin configurations with a device, use a pinctrl-N property for some
    number N, like this example you could place in your board's DTS file:

       #include "board-pinctrl.dtsi"

       &usarta {
             pinctrl-0 = <&usarta_default>;
             pinctrl-names = "default";
       };

compatible: "qorvo,pac55xx-pinctrl"

include: base.yaml

child-binding:
  child-binding:
    include:
      - name: pincfg-node.yaml
        property-allowlist:
          - drive-push-pull
          - drive-open-drain
          - bias-pull-down
          - bias-pull-up
          - drive-strength
          - input-schmitt-enable

    properties:
      pinmux:
        required: true
        type: array
        description: |
          An array of pins sharing the same group properties. The pins should
          be defined using pre-defined macros or, alternatively, using the
          PAC55XX_PINMUX helper macro.

      drive-strength:
        default: 6
        enum:
          - 6
          - 8
          - 11
          - 14
          - 17
          - 20
          - 22
          - 25
```

## dts/bindings/sensor/memsic,mmc5633njl.yaml
```yaml
# SPDX-License-Identifier: Apache-2.0
# Copyright (c) 2024 Nordic Semiconductor

description: MMC5633NJL 3-axis magnetic sensor

compatible: "memsic,mmc5633njl"

include: [sensor-device.yaml, i3c-device.yaml]
```

## dts/bindings/serial/qorvo,pac55xx-usart.yaml
```yaml
# Copyright (c) 2023 Teslabs Engineering S.L.
# SPDX-License-Identifier: Apache-2.0

description: Qorvo PAC55XX USART

compatible: "qorvo,pac55xx-usart"

include: [uart-controller.yaml, pinctrl-device.yaml]

properties:
  reg:
    required: true

  interrupts:
    required: true

  pinctrl-0:
    required: true

  pinctrl-names:
    required: true

  qorvo,mode-flag:
    type: int
    required: true
    description: Mode flag in the CCS configuration register
```
