/*
 * Copyright (c) 2024 Nordic Semiconductor ASA
 *
 * SPDX-License-Identifier: Apache-2.0
 */

/dts-v1/;

#include <nordic/nrf54l15_cpuapp.dtsi>

/ {
	chosen {
		zephyr,flash = &cpuapp_rram;
		zephyr,sram = &cpuapp_sram;
	};
};
