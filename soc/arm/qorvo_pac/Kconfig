## soc/arm/qorvo_pac/Kconfig
```kconfig
# Copyright (c) 2023 Teslabs Engineering S.L.
# SPDX-License-Identifier: Apache-2.0

config SOC_FAMILY_QORVO_PAC
	bool

if SOC_FAMILY_QORVO_PAC

source "soc/arm/qorvo_pac/*/Kconfig.soc"

endif # SOC_FAMILY_QORVO_PAC
```

## soc/arm/qorvo_pac/Kconfig.defconfig
```kconfig
# Copyright (c) 2023 Teslabs Engineering S.L.
# SPDX-License-Identifier: Apache-2.0

config SOC_FAMILY
	default "qorvo_pac" if SOC_FAMILY_QORVO_PAC

source "soc/arm/qorvo_pac/*/Kconfig.defconfig"
```

## soc/arm/qorvo_pac/Kconfig.soc
```kconfig
# Copyright (c) 2023 Teslabs Engineering S.L.
# SPDX-License-Identifier: Apache-2.0

source "soc/arm/qorvo_pac/*/Kconfig.series"
```

## soc/arm/qorvo_pac/pac55xx/Kconfig.defconfig
```kconfig
# Copyright (c) 2023, Teslabs Engineering S.L.
# SPDX-License-Identifier: Apache-2.0

if SOC_SERIES_PAC55XX

config SOC
	default "pac5527" if SOC_PAC5527

config SOC_SERIES
	default "pac55xx"

config SYS_CLOCK_HW_CYCLES_PER_SEC
	default $(dt_node_int_prop_int,/cpus/cpu@0,clock-frequency)

config NUM_IRQS
	default 32

config BUILD_OUTPUT_HEX
	default y

endif # SOC_SERIES_PAC55XX
```

## soc/arm/qorvo_pac/pac55xx/Kconfig.series
```kconfig
# Copyright (c) 2023, Teslabs Engineering S.L.
# SPDX-License-Identifier: Apache-2.0

config SOC_SERIES_PAC55XX
	bool "Qorvo PAC55XX series Cortex-M4F MCU"
	select ARM
	select CPU_HAS_ARM_MPU
	select CPU_HAS_FPU
	select CPU_CORTEX_M4
	select SOC_FAMILY_QORVO_PAC
	select HAS_SEGGER_RTT if ZEPHYR_SEGGER_MODULE
	help
	  Enable support for Qorvo PAC55XX MCU series
```

## soc/arm/qorvo_pac/pac55xx/Kconfig.soc
```kconfig
# Copyright (c) 2023, Teslabs Engineering S.L.
# SPDX-License-Identifier: Apache-2.0

choice
	prompt "Qorvo PAC55XX MCU Selection"
	depends on SOC_SERIES_PAC55XX

	config SOC_PAC5527
		bool "PAC5527"

endchoice
```
